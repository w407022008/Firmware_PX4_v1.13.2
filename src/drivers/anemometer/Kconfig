## src/drivers/anemometer/Kconfig
```kconfig
menu "Anemometer sensors"
    menuconfig COMMON_ANEMOMETER
        bool "Common anemometer's"
        default n
        select DRIVERS_ANEMOMETER_SFM3000
        ---help---
            Enable default set of anemometer sensor drivers

    rsource "*/Kconfig"
endmenu
```

## src/modules/data_record/Kconfig
```kconfig
menuconfig MODULES_DATA_RECORD
	bool "data_record"
	default n
	---help---
		Enable support for data_record

menuconfig USER_DATA_RECORD
	bool "data_record running as userspace module"
	default y
	depends on BOARD_PROTECTED && MODULES_DATA_RECORD
	---help---
		Put data_record in userspace memory
```
